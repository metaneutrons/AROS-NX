## arch/riscv-esp32p4/tools/hosted-reference/sdkconfig.defaults
```kconfig
CONFIG_IDF_TARGET="esp32p4"
CONFIG_ESP_CONSOLE_USB_SERIAL_JTAG=y
CONFIG_ESP_SDIO_HOST_INTERFACE=y
CONFIG_ESP_SDIO_GPIO_RESET_SLAVE=-1
CONFIG_ESP_SDIO_CLOCK_FREQ_KHZ=400
CONFIG_ESP_SDIO_1_BIT_BUS=y
CONFIG_ESP_SDIO_PIN_CLK=18
CONFIG_ESP_SDIO_PIN_CMD=19
CONFIG_ESP_SDIO_PIN_D0=14
CONFIG_ESP_SDIO_PIN_D1=15
CONFIG_ESP_WIFI_REMOTE_LIBRARY_HOSTED=y
CONFIG_SPIRAM=n
CONFIG_ESPTOOLPY_FLASHSIZE_16MB=y
CONFIG_ESPTOOLPY_FLASHMODE_DIO=y
CONFIG_ESP32P4_REV_MIN_100=y
CONFIG_ESP32P4_REV_MAX_FULL=199
```
