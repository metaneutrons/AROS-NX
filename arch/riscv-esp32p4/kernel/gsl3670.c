/*
    Copyright (C) 2026, The AROS Development Team. All rights reserved.

    Desc: Bounded D1001 GSL3670 reset and RAM-firmware transport.
*/

/*
 * This file contains no touch-controller firmware.  C4 diagnostic builds may
 * name a private header generated by tools/convert-gsl-firmware.py.  That
 * header stays outside the source tree and supplies only the record array.
 * A normal build neither includes nor executes this code path.
 *
 * The controller loses its program when it loses power.  Every transaction is
 * therefore checked and the first failure stops the load.  No retry loop can
 * hide a broken bus or hold the boot forever: krnP4I2CTransfer() itself has a
 * 50-ms deadline, and this layer attempts every record at most once.
 */

#include <inttypes.h>
#include <exec/types.h>

#include "hardware.h"
#include "kernel_intern.h"

#ifdef P4_C4_TOUCH_LOAD

#ifndef P4_GSL_FW_HEADER
#error P4_C4_TOUCH_LOAD requires a private P4_GSL_FW_HEADER
#endif

struct P4GSLFirmwareRecord
{
    unsigned char offset;
    unsigned long value;
};

#include P4_GSL_FW_HEADER

#define GSL_RESET_WAIT_TICKS   2U  /* 20 ms with the 100-Hz kernel timer */
#define GSL_SHORT_WAIT_TICKS   1U  /* bounded 10 ms; timer granularity */
#define GSL_STATUS_WAIT_TICKS  3U  /* 30 ms */

static int gsl_expander_read16(unsigned char reg, UWORD *value)
{
    unsigned char data[2] = { 0, 0 };
    int r = krnP4I2CTransfer(P4_PCA9535_ADDR, &reg, 1, data, 2);

    if (r == P4_I2C_OK)
        *value = (UWORD)(data[0] | ((UWORD)data[1] << 8));
    return r;
}

static int gsl_expander_write16(unsigned char reg, UWORD value)
{
    unsigned char data[3];

    data[0] = reg;
    data[1] = (unsigned char)value;
    data[2] = (unsigned char)(value >> 8);
    return krnP4I2CTransfer(P4_PCA9535_ADDR, data, 3, NULL, 0);
}

static int gsl_expander_write_checked(unsigned char reg, UWORD value)
{
    UWORD readback = 0;
    int r = gsl_expander_write16(reg, value);

    if (r != P4_I2C_OK)
        return r;
    r = gsl_expander_read16(reg, &readback);
    if (r != P4_I2C_OK)
        return r;
    return readback == value ? P4_I2C_OK : P4_I2C_MISMATCH;
}

/*
 * Pulse only PCA9535 output 12, preserving every unrelated latch and
 * direction bit.  The low value is installed in the latch before an inherited
 * input is changed to an output, so claiming the pin cannot produce a high
 * glitch.  It remains a driven high output afterwards because that is the
 * controller's released-reset operating state.
 */
static int gsl_hardware_reset(void)
{
    UWORD output = 0, config = 0;
    int r;

    if (!krnP4I2CInit(1, P4_D1001_I2C1_SDA_GPIO,
                      P4_D1001_I2C1_SCL_GPIO, 100000UL))
        return P4_I2C_NOTREADY;

    r = gsl_expander_read16(P4_PCA9535_OUTPUT, &output);
    if (r != P4_I2C_OK)
        return r;
    r = gsl_expander_read16(P4_PCA9535_CONFIG, &config);
    if (r != P4_I2C_OK)
        return r;

    r = gsl_expander_write_checked(P4_PCA9535_OUTPUT,
                                   (UWORD)(output & ~P4_EXP_TOUCH_RST));
    if (r != P4_I2C_OK)
        return r;
    r = gsl_expander_write_checked(P4_PCA9535_CONFIG,
                                   (UWORD)(config & ~P4_EXP_TOUCH_RST));
    if (r != P4_I2C_OK)
        return r;
    krnTimerWait(GSL_RESET_WAIT_TICKS);

    r = gsl_expander_write_checked(P4_PCA9535_OUTPUT,
                                   (UWORD)(output | P4_EXP_TOUCH_RST));
    if (r != P4_I2C_OK)
        return r;
    krnTimerWait(GSL_RESET_WAIT_TICKS);
    return P4_I2C_OK;
}

static int gsl_select_bus(void)
{
    return krnP4I2CInit(0, P4_D1001_I2C0_SDA_GPIO,
                        P4_D1001_I2C0_SCL_GPIO, 10000UL)
         ? P4_I2C_OK : P4_I2C_NOTREADY;
}

static int gsl_write(unsigned char reg, unsigned long value,
                     unsigned int bytes)
{
    unsigned char data[5];
    unsigned int i;

    data[0] = reg;
    for (i = 0; i < bytes; ++i)
        data[i + 1] = (unsigned char)(value >> (i * 8));
    return krnP4I2CTransfer(P4_D1001_TOUCH_ADDR, data, bytes + 1, NULL, 0);
}

static int gsl_read32(unsigned char reg, uint32_t *value)
{
    unsigned char data[4] = { 0, 0, 0, 0 };
    int r = krnP4I2CTransfer(P4_D1001_TOUCH_ADDR, &reg, 1, data, 4);

    if (r == P4_I2C_OK)
        *value = (uint32_t)data[0] | ((uint32_t)data[1] << 8)
               | ((uint32_t)data[2] << 16) | ((uint32_t)data[3] << 24);
    return r;
}

static int gsl_clear_registers(void)
{
    int r = gsl_hardware_reset();

    if (r != P4_I2C_OK)
        return r;
    if ((r = gsl_select_bus()) != P4_I2C_OK)
        return r;
    if ((r = gsl_write(0x88, 0x01, 1)) != P4_I2C_OK)
        return r;
    krnTimerWait(GSL_SHORT_WAIT_TICKS);
    if ((r = gsl_write(0xE4, 0x04, 1)) != P4_I2C_OK)
        return r;
    krnTimerWait(GSL_SHORT_WAIT_TICKS);
    if ((r = gsl_write(0xE0, 0x00, 1)) != P4_I2C_OK)
        return r;
    krnTimerWait(GSL_RESET_WAIT_TICKS);
    return P4_I2C_OK;
}

static int gsl_reset_registers(void)
{
    int r = gsl_hardware_reset();

    if (r != P4_I2C_OK)
        return r;
    if ((r = gsl_select_bus()) != P4_I2C_OK)
        return r;
    if ((r = gsl_write(0xE4, 0x04, 1)) != P4_I2C_OK)
        return r;
    krnTimerWait(GSL_SHORT_WAIT_TICKS);
    if ((r = gsl_write(0xBC, 0x00000000UL, 4)) != P4_I2C_OK)
        return r;
    krnTimerWait(GSL_SHORT_WAIT_TICKS);
    return P4_I2C_OK;
}

static int gsl_load_firmware(unsigned int *failed_record)
{
    unsigned int i;

    for (i = 0; i < P4_GSL_FW_RECORD_COUNT; ++i)
    {
        const struct P4GSLFirmwareRecord *record = &p4_gsl_firmware[i];
        int r = gsl_write(record->offset, record->value,
                          record->offset == 0xF0 ? 1 : 4);

        if (r != P4_I2C_OK)
        {
            *failed_record = i;
            return r;
        }
        if ((i & 0x3FFU) == 0x3FFU)
        {
            krnP4PutStr("[touch]  firmware records sent ");
            krnP4PutDec(i + 1);
            krnP4PutStr("/");
            krnP4PutDec(P4_GSL_FW_RECORD_COUNT);
            krnP4PutStr("\n");
        }
    }
    return P4_I2C_OK;
}

static int gsl_start(void)
{
    int r = gsl_write(0xE0, 0x00, 1);

    if (r == P4_I2C_OK)
        krnTimerWait(GSL_SHORT_WAIT_TICKS);
    return r;
}

/*
 * Diagnostic-only complete bootstrap.  Success means only that the volatile
 * program is alive and that one bounded status read matches; input reporting
 * and HIDD integration are deliberately later gates.
 */
int krnP4GSLLoadDiagnostic(uint32_t *status, unsigned int *failed_record)
{
    int r;

    *status = 0;
    *failed_record = 0;

    krnP4PutStr("[touch]  private firmware records ");
    krnP4PutDec(P4_GSL_FW_RECORD_COUNT);
    krnP4PutStr(", sha256 " P4_GSL_FW_SHA256 "\n");

    if ((r = gsl_clear_registers()) != P4_I2C_OK)
        goto out;
    if ((r = gsl_reset_registers()) != P4_I2C_OK)
        goto out;
    if ((r = gsl_load_firmware(failed_record)) != P4_I2C_OK)
        goto out;
    if ((r = gsl_start()) != P4_I2C_OK)
        goto out;
    if ((r = gsl_reset_registers()) != P4_I2C_OK)
        goto out;
    if ((r = gsl_start()) != P4_I2C_OK)
        goto out;
    krnTimerWait(GSL_STATUS_WAIT_TICKS);
    r = gsl_read32(0xB0, status);
    if (r == P4_I2C_OK && *status != 0x5A5A5A5AUL)
        r = P4_I2C_MISMATCH;

out:
    /* The normal C3 display path owns the singleton transport after C4. */
    if (!krnP4I2CInit(1, P4_D1001_I2C1_SDA_GPIO,
                      P4_D1001_I2C1_SCL_GPIO, 100000UL)
        && r == P4_I2C_OK)
        r = P4_I2C_NOTREADY;
    return r;
}

#endif /* P4_C4_TOUCH_LOAD */
